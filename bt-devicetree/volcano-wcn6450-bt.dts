/dts-v1/;
/plugin/;

#include "volcano-wcn6450-bt.dtsi"

/ {
        model = "Qualcomm Technologies, Inc. Volcano SoC";
        compatible = "qcom,volcano";
        qcom,msm-id = <636 0x10000>, <640 0x10000>, <641 0x10000>;
        qcom,board-id = <34 4>, <34 5>, <8 9>, <8 10>;
};

