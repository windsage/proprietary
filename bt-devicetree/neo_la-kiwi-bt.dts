/dts-v1/;
/plugin/;

#include "neo_la-kiwi-bt.dtsi"

/ {
	model = "Qualcomm Technologies, Inc. Neo HMT";
	compatible = "qcom,neo-idp", "qcom,neo", "qcom,idp";
	qcom,msm-id = <554 0x10000>, <525 0x10000>, <579 0x10000>;
	qcom,board-id = <0 0>, <33 0>, <34 0>, <34 1>, <34 2>, <34 3>, <0x1000F 0>, <0x1000f 0x0400>;
};
